## drivers/video/Kconfig.ov2640_esp32s3
```kconfig
# OV2640 camera sensor driver configuration

config VIDEO_OV2640_ESP32S3
	bool "OV2640 camera sensor driver for ESP32S3"
	depends on DT_HAS_OVTI_OV2640_ESP32S3_ENABLED
	depends on SOC_ESP32S3
	select VIDEO
	select VIDEO_BUFFER
	select DMA
	select I2C
	select GPIO
	help
	  Enable driver for OV2640 camera sensor on ESP32S3.
	  This driver provides a bridge between Zephyr's video API
	  and ESP-IDF camera driver functionality.

if VIDEO_OV2640_ESP32S3

config VIDEO_OV2640_ESP32S3_INIT_PRIORITY
	int "OV2640 driver initialization priority"
	default 90
	help
	  OV2640 driver initialization priority. Should be initialized
	  after I2C but before applications.

endif # VIDEO_OV2640_ESP32S3 
```

## dts/bindings/video/ovti,ov2640.yaml
```yaml
# Device tree binding for OV2640 camera sensor
# Compatible with Zephyr video subsystem

description: |
  OV2640 camera sensor from OmniVision Technologies.
  This is a 2 megapixel CMOS image sensor with UXGA resolution
  and JPEG output capability.

compatible: "ovti,ov2640"

include: [sensor-device.yaml, i2c-device.yaml]

properties:
  reg:
    required: true
    description: I2C address of the sensor

  xclk-frequency:
    type: int
    description: External clock frequency in Hz
    default: 20000000

  reset-gpios:
    type: phandle-array
    description: GPIO for reset signal (active low)

  powerdown-gpios:
    type: phandle-array  
    description: GPIO for powerdown signal (active high)

  port:
    type: compound
    description: Video port for camera interface 
```
